## sdkconfig.defaults
```kconfig
# WT32-SC01 Plus (ESP32-S3, 16MB QIO flash, 2MB QSPI PSRAM)
CONFIG_IDF_TARGET="esp32s3"

CONFIG_ESPTOOLPY_FLASHMODE_QIO=y
CONFIG_ESPTOOLPY_FLASHSIZE_16MB=y
CONFIG_ESPTOOLPY_FLASHFREQ_80M=y

CONFIG_SPIRAM=y
CONFIG_SPIRAM_MODE_QUAD=y

# IDF's defaults leave real perf on the table for a UI-heavy app: CPU clocked
# at 160MHz instead of the S3's max 240MHz, and the app compiled at IDF's
# default -Og (Debug) instead of -O2. LVGL's software renderer is CPU-bound,
# so both matter a lot here. "Performance" keeps assertions enabled (unlike
# IDF's "Release" preset), which is a reasonable tradeoff for a hobby project
# still under active development.
CONFIG_ESP_DEFAULT_CPU_FREQ_MHZ_240=y
CONFIG_COMPILER_OPTIMIZATION_PERF=y

# LVGL wants a decently sized main task stack; the UI + touch handling run on it.
CONFIG_ESP_MAIN_TASK_STACK_SIZE=8192

CONFIG_FREERTOS_HZ=1000

# Custom layout (see partitions.csv): two 4MB OTA app slots -- WiFi/TLS/
# HTTP/JSON already push the app well past the default 1MB partition, and
# 16MB of flash has plenty of room to spare -- plus a dedicated "actypes"
# NVS partition for aircraft_type_client's on-flash lookup cache.
CONFIG_PARTITION_TABLE_CUSTOM=y
CONFIG_PARTITION_TABLE_CUSTOM_FILENAME="partitions.csv"

# LVGL's own built-in sprintf doesn't format floats correctly; use the C
# library's instead (see main/radar_view.cpp's range label for why this
# matters).
CONFIG_LV_USE_CLIB_SPRINTF=y

# IDF's default puts mbedTLS's buffers/contexts (16KB in + 4KB out content
# buffers per handshake, plus session state) in internal RAM, which this
# board only has ~270KB of, shared with WiFi buffers, LVGL, etc. Once several
# TLS clients (OpenSky, airports, adsbdb, Overpass) have each done a few
# handshakes, internal-heap fragmentation causes mbedtls_ssl_setup() to start
# failing allocation permanently -- looks like "OpenSky fetch failed" forever
# with WiFi still fully connected. Route mbedTLS's allocations to the 2MB of
# SPIRAM this board has instead, since it's otherwise mostly idle.
CONFIG_MBEDTLS_EXTERNAL_MEM_ALLOC=y
```
